## 1-Andoird_Sources/ch06/word_count/kconfig
```kconfig
config WORD_COUNT
    tristate "word_count driver" 
    default y
    help
        This is a word count driver. It can get a word count from /dev/wordcount
 
```
